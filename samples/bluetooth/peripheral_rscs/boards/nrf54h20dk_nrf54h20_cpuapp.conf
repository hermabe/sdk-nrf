## samples/bluetooth/peripheral_rscs/boards/nrf54h20dk_nrf54h20_cpuapp.conf
```kconfig
# Configs for multi-image build
CONFIG_OPENAMP=y
CONFIG_OPENAMP_SLAVE=n

CONFIG_MBOX=y
CONFIG_IPC_SERVICE=y

# nrf54: To suppress warnings about arm_core_mpu_configure_dynamic_mpu_regions
CONFIG_ARM_MPU=n

CONFIG_LOG_PRINTK=y
CONFIG_SERIAL=y
CONFIG_CONSOLE=y
CONFIG_UART_CONSOLE=y
CONFIG_LOG_BACKEND_UART=y
```
